## CMakeLists.txt
```
# SPDX-License-Identifier: Apache-2.0

cmake_minimum_required(VERSION 3.20.0)

# Add Fusain protocol library
list(APPEND EXTRA_ZEPHYR_MODULES ${CMAKE_CURRENT_SOURCE_DIR}/../../../../../modules/lib/fusain)

find_package(Zephyr REQUIRED HINTS $ENV{ZEPHYR_BASE})

project(bucket)

target_sources(app PRIVATE
  src/main.c
  src/ws_fusain.c
)

# Directory containing web resources to serve
set(WEB_RESOURCES_DIR ${CMAKE_CURRENT_SOURCE_DIR}/web)
set(gen_dir ${ZEPHYR_BINARY_DIR}/include/generated/)

# Generate gzip-compressed include files for web resources
# These files will be embedded in the firmware
# Use CMake to define HAS_* macros since __has_include() doesn't work
# with build-time generated files
if(EXISTS ${WEB_RESOURCES_DIR}/index.html)
  generate_inc_file_for_target(app
    ${WEB_RESOURCES_DIR}/index.html
    ${gen_dir}/index.html.gz.inc
    --gzip
  )
  target_compile_definitions(app PRIVATE HAS_INDEX_HTML=1)
else()
  target_compile_definitions(app PRIVATE HAS_INDEX_HTML=0)
endif()

if(EXISTS ${WEB_RESOURCES_DIR}/app.js)
  generate_inc_file_for_target(app
    ${WEB_RESOURCES_DIR}/app.js
    ${gen_dir}/app.js.gz.inc
    --gzip
  )
  target_compile_definitions(app PRIVATE HAS_APP_JS=1)
else()
  target_compile_definitions(app PRIVATE HAS_APP_JS=0)
endif()

if(EXISTS ${WEB_RESOURCES_DIR}/app.css)
  generate_inc_file_for_target(app
    ${WEB_RESOURCES_DIR}/app.css
    ${gen_dir}/app.css.gz.inc
    --gzip
  )
  target_compile_definitions(app PRIVATE HAS_APP_CSS=1)
else()
  target_compile_definitions(app PRIVATE HAS_APP_CSS=0)
endif()

if(EXISTS ${WEB_RESOURCES_DIR}/favicon.svg)
  generate_inc_file_for_target(app
    ${WEB_RESOURCES_DIR}/favicon.svg
    ${gen_dir}/favicon.svg.gz.inc
    --gzip
  )
  target_compile_definitions(app PRIVATE HAS_FAVICON_SVG=1)
else()
  target_compile_definitions(app PRIVATE HAS_FAVICON_SVG=0)
endif()

if(EXISTS ${WEB_RESOURCES_DIR}/favicon.ico)
  generate_inc_file_for_target(app
    ${WEB_RESOURCES_DIR}/favicon.ico
    ${gen_dir}/favicon.ico.gz.inc
    --gzip
  )
  target_compile_definitions(app PRIVATE HAS_FAVICON_ICO=1)
else()
  target_compile_definitions(app PRIVATE HAS_FAVICON_ICO=0)
endif()

# Linker section for HTTP resources
zephyr_linker_sources(SECTIONS sections-rom.ld)
```

## prj.conf
```kconfig
# SPDX-License-Identifier: Apache-2.0
#
# Bucket - Minimal HTTP server for serving experiment build outputs
# Target: Raspberry Pi Pico 2W (RP2350A with CYW43 WiFi)

# General kernel config
CONFIG_MAIN_STACK_SIZE=4096
CONFIG_SYSTEM_WORKQUEUE_STACK_SIZE=2048
CONFIG_INIT_STACKS=y
CONFIG_POSIX_API=y
CONFIG_ENTROPY_GENERATOR=y
CONFIG_TEST_RANDOM_GENERATOR=y

# Shell (for WiFi configuration)
CONFIG_SHELL=y
CONFIG_SHELL_STACK_SIZE=4096
CONFIG_DEVICE_SHELL=y

# Logging
CONFIG_LOG=y
CONFIG_SHELL_LOG_BACKEND=y
CONFIG_LOG_RUNTIME_FILTERING=y
CONFIG_LOG_DEFAULT_LEVEL=3

# Networking core
CONFIG_NETWORKING=y
CONFIG_NET_IPV4=y
CONFIG_NET_IPV6=n
CONFIG_NET_TCP=y
CONFIG_NET_UDP=y
CONFIG_NET_SOCKETS=y

# Network buffers
CONFIG_NET_PKT_RX_COUNT=16
CONFIG_NET_PKT_TX_COUNT=16
CONFIG_NET_BUF_RX_COUNT=64
CONFIG_NET_BUF_TX_COUNT=64
CONFIG_NET_MAX_CONTEXTS=16
CONFIG_NET_MAX_CONN=16
CONFIG_NET_CONTEXT_NET_PKT_POOL=y

# WiFi
CONFIG_WIFI=y
CONFIG_WIFI_LOG_LEVEL_INF=y
CONFIG_NET_L2_WIFI_MGMT=y
CONFIG_NET_L2_WIFI_SHELL=y
CONFIG_NET_MGMT=y
CONFIG_NET_MGMT_EVENT=y
CONFIG_NET_MGMT_EVENT_INFO=y
CONFIG_NET_MGMT_EVENT_QUEUE_SIZE=16
CONFIG_NET_MGMT_EVENT_QUEUE_TIMEOUT=5000
CONFIG_NET_MGMT_EVENT_STACK_SIZE=4096
CONFIG_NET_CONNECTION_MANAGER=y

# DHCP server (for AP mode)
CONFIG_NET_DHCPV4_SERVER=y
CONFIG_NET_DHCPV4_SERVER_LOG_LEVEL_INF=y

# DHCP client (for STA mode)
CONFIG_NET_DHCPV4=y

# Static IP configuration (for AP mode)
CONFIG_NET_CONFIG_SETTINGS=y
CONFIG_NET_CONFIG_MY_IPV4_ADDR="192.168.4.1"
CONFIG_NET_CONFIG_MY_IPV4_NETMASK="255.255.255.0"

# Network shell for debugging
CONFIG_NET_SHELL=y
CONFIG_NET_STATISTICS=y
CONFIG_NET_LOG=y

# HTTP Server
CONFIG_HTTP_PARSER=y
CONFIG_HTTP_PARSER_URL=y
CONFIG_HTTP_SERVER=y
CONFIG_HTTP_SERVER_MAX_CLIENTS=4
CONFIG_HTTP_SERVER_MAX_URL_LENGTH=128

# WebSocket support (for Fusain endpoint)
CONFIG_HTTP_SERVER_WEBSOCKET=y
CONFIG_WEBSOCKET_MAX_CONTEXTS=4

# Fusain protocol library
CONFIG_FUSAIN=y

# GPIO (required for CYW43 WiFi chip)
CONFIG_GPIO=y

# Hardware info (for unique SSID generation)
CONFIG_HWINFO=y
CONFIG_HWINFO_RPI_PICO_CHIP_ID=y

# Poll support
CONFIG_ZVFS_POLL_MAX=32
CONFIG_EVENTFD=y
CONFIG_ZVFS_EVENTFD_MAX=8
```

## src/main.c
```c
/*
 * SPDX-License-Identifier: Apache-2.0
 *
 * Bucket - Minimal HTTP server for serving experiment build outputs
 *
 * This firmware serves static web files from flash over WiFi.
 * Configure WiFi via shell:
 *   wifi ap enable Bucket-XXXX     # Start AP mode
 *   wifi connect <ssid> <psk>      # Or connect to existing network
 */

#include <zephyr/kernel.h>
#include <zephyr/logging/log.h>
#include <zephyr/net/http/server.h>
#include <zephyr/net/http/service.h>
#include <zephyr/net/net_if.h>
#include <zephyr/net/net_config.h>
#include <zephyr/net/wifi_mgmt.h>
#include <zephyr/net/dhcpv4_server.h>
#include <zephyr/net/websocket.h>
#include <zephyr/drivers/hwinfo.h>

/* WebSocket handler from ws_fusain.c */
extern int ws_fusain_setup(int ws_socket, struct http_request_ctx *request_ctx,
                           void *user_data);

LOG_MODULE_REGISTER(bucket, LOG_LEVEL_INF);

//////////////////////////////////////////////////////////////
// Config
//////////////////////////////////////////////////////////////

#define AP_SSID_PREFIX "Bucket-"
#define DHCP_BASE_ADDR 0xC0A80402 /* 192.168.4.2 */

//////////////////////////////////////////////////////////////
// Static Web Resources (embedded at compile time)
//////////////////////////////////////////////////////////////

/* HAS_INDEX_HTML, HAS_APP_JS, HAS_APP_CSS are defined by CMake based on
 * whether the source files exist in web/ at configure time.
 * __has_include() doesn't work here because the .inc files are generated
 * by build targets that run after preprocessing. */

#if HAS_INDEX_HTML
static uint8_t index_html_gz[] = {
#include "index.html.gz.inc"
};
#endif

#if HAS_APP_JS
static uint8_t app_js_gz[] = {
#include "app.js.gz.inc"
};
#endif

#if HAS_APP_CSS
static uint8_t app_css_gz[] = {
#include "app.css.gz.inc"
};
#endif

#if HAS_FAVICON_SVG
static uint8_t favicon_svg_gz[] = {
#include "favicon.svg.gz.inc"
};
#endif

#if HAS_FAVICON_ICO
static uint8_t favicon_ico_gz[] = {
#include "favicon.ico.gz.inc"
};
#endif

//////////////////////////////////////////////////////////////
// HTTP Resources
//////////////////////////////////////////////////////////////

#if HAS_INDEX_HTML
static struct http_resource_detail_static index_html_resource = {
    .common = {
        .type = HTTP_RESOURCE_TYPE_STATIC,
        .bitmask_of_supported_http_methods = BIT(HTTP_GET),
        .content_encoding = "gzip",
        .content_type = "text/html",
    },
    .static_data = index_html_gz,
    .static_data_len = sizeof(index_html_gz),
};
#endif

#if HAS_APP_JS
static struct http_resource_detail_static app_js_resource = {
    .common = {
        .type = HTTP_RESOURCE_TYPE_STATIC,
        .bitmask_of_supported_http_methods = BIT(HTTP_GET),
        .content_encoding = "gzip",
        .content_type = "application/javascript",
    },
    .static_data = app_js_gz,
    .static_data_len = sizeof(app_js_gz),
};
#endif

#if HAS_APP_CSS
static struct http_resource_detail_static app_css_resource = {
    .common = {
        .type = HTTP_RESOURCE_TYPE_STATIC,
        .bitmask_of_supported_http_methods = BIT(HTTP_GET),
        .content_encoding = "gzip",
        .content_type = "text/css",
    },
    .static_data = app_css_gz,
    .static_data_len = sizeof(app_css_gz),
};
#endif

#if HAS_FAVICON_SVG
static struct http_resource_detail_static favicon_svg_resource = {
    .common = {
        .type = HTTP_RESOURCE_TYPE_STATIC,
        .bitmask_of_supported_http_methods = BIT(HTTP_GET),
        .content_encoding = "gzip",
        .content_type = "image/svg+xml",
    },
    .static_data = favicon_svg_gz,
    .static_data_len = sizeof(favicon_svg_gz),
};
#endif

#if HAS_FAVICON_ICO
static struct http_resource_detail_static favicon_ico_resource = {
    .common = {
        .type = HTTP_RESOURCE_TYPE_STATIC,
        .bitmask_of_supported_http_methods = BIT(HTTP_GET),
        .content_encoding = "gzip",
        .content_type = "image/x-icon",
    },
    .static_data = favicon_ico_gz,
    .static_data_len = sizeof(favicon_ico_gz),
};
#endif

/* Fallback response when no web content is available */
static const char no_content_html[] =
    "<html><head><title>Bucket</title></head><body>"
    "<h1>Bucket HTTP Server</h1>"
    "<p>No web content deployed. Copy experiment build to bucket/web/</p>"
    "<p>Use WiFi shell commands to configure network.</p>"
    "</body></html>";

static struct http_resource_detail_static no_content_resource = {
    .common = {
        .type = HTTP_RESOURCE_TYPE_STATIC,
        .bitmask_of_supported_http_methods = BIT(HTTP_GET),
        .content_type = "text/html",
    },
    .static_data = (uint8_t *)no_content_html,
    .static_data_len = sizeof(no_content_html) - 1,
};

//////////////////////////////////////////////////////////////
// HTTP Service Definition
//////////////////////////////////////////////////////////////

#define HTTP_PORT 80

static uint16_t http_port = HTTP_PORT;

HTTP_SERVICE_DEFINE(bucket_service, NULL, &http_port,
                    CONFIG_HTTP_SERVER_MAX_CLIENTS, 10, NULL, NULL, NULL);

/* Register resources */
#if HAS_INDEX_HTML
HTTP_RESOURCE_DEFINE(index_resource, bucket_service, "/", &index_html_resource);
HTTP_RESOURCE_DEFINE(index_html_explicit, bucket_service, "/index.html",
                     &index_html_resource);
#else
HTTP_RESOURCE_DEFINE(index_resource, bucket_service, "/", &no_content_resource);
#endif

#if HAS_APP_JS
HTTP_RESOURCE_DEFINE(app_js_res, bucket_service, "/app.js", &app_js_resource);
HTTP_RESOURCE_DEFINE(assets_app_js, bucket_service, "/assets/app.js",
                     &app_js_resource);
#endif

#if HAS_APP_CSS
HTTP_RESOURCE_DEFINE(app_css_res, bucket_service, "/app.css", &app_css_resource);
HTTP_RESOURCE_DEFINE(assets_app_css, bucket_service, "/assets/app.css",
                     &app_css_resource);
#endif

#if HAS_FAVICON_SVG
HTTP_RESOURCE_DEFINE(favicon_svg, bucket_service, "/favicon.svg",
                     &favicon_svg_resource);
#endif

#if HAS_FAVICON_ICO
HTTP_RESOURCE_DEFINE(favicon_ico, bucket_service, "/favicon.ico",
                     &favicon_ico_resource);
#endif

//////////////////////////////////////////////////////////////
// WebSocket Endpoint
//////////////////////////////////////////////////////////////

static uint8_t ws_fusain_buffer[256];

static struct http_resource_detail_websocket ws_fusain_resource_detail = {
    .common = {
        .type = HTTP_RESOURCE_TYPE_WEBSOCKET,
        .bitmask_of_supported_http_methods = BIT(HTTP_GET),
    },
    .cb = ws_fusain_setup,
    .data_buffer = ws_fusain_buffer,
    .data_buffer_len = sizeof(ws_fusain_buffer),
};

HTTP_RESOURCE_DEFINE(ws_fusain, bucket_service, "/ws/fusain",
                     &ws_fusain_resource_detail);

//////////////////////////////////////////////////////////////
// WiFi Event Handling
//////////////////////////////////////////////////////////////

static struct net_mgmt_event_callback wifi_cb;

static void wifi_event_handler(struct net_mgmt_event_callback *cb,
                               uint64_t mgmt_event, struct net_if *iface) {
  switch (mgmt_event) {
  case NET_EVENT_WIFI_CONNECT_RESULT: {
    const struct wifi_status *status =
        (const struct wifi_status *)cb->info;
    if (status->status == 0) {
      LOG_INF("WiFi connected");
    } else {
      LOG_ERR("WiFi connection failed: %d", status->status);
    }
    break;
  }
  case NET_EVENT_WIFI_DISCONNECT_RESULT:
    LOG_INF("WiFi disconnected");
    break;
  case NET_EVENT_WIFI_AP_ENABLE_RESULT:
    LOG_INF("WiFi AP mode enabled");
    break;
  case NET_EVENT_WIFI_AP_DISABLE_RESULT:
    LOG_INF("WiFi AP mode disabled");
    break;
  case NET_EVENT_WIFI_AP_STA_CONNECTED:
    LOG_INF("Client connected to AP");
    break;
  case NET_EVENT_WIFI_AP_STA_DISCONNECTED:
    LOG_INF("Client disconnected from AP");
    break;
  default:
    break;
  }
}

//////////////////////////////////////////////////////////////
// SSID Generation
//////////////////////////////////////////////////////////////

static void generate_ssid(char *ssid, size_t len) {
  uint8_t device_id[8];
  ssize_t id_len = hwinfo_get_device_id(device_id, sizeof(device_id));

  if (id_len >= 4) {
    snprintf(ssid, len, "%s%02X%02X%02X%02X", AP_SSID_PREFIX,
             device_id[id_len - 4], device_id[id_len - 3],
             device_id[id_len - 2], device_id[id_len - 1]);
  } else {
    snprintf(ssid, len, "%s0000", AP_SSID_PREFIX);
  }
}

//////////////////////////////////////////////////////////////
// Main
//////////////////////////////////////////////////////////////

int main(void) {
  char ssid[32];

  generate_ssid(ssid, sizeof(ssid));
  LOG_INF("Bucket HTTP Server");
  LOG_INF("Suggested AP SSID: %s", ssid);

  /* Register WiFi event callbacks */
  net_mgmt_init_event_callback(
      &wifi_cb, wifi_event_handler,
      NET_EVENT_WIFI_CONNECT_RESULT | NET_EVENT_WIFI_DISCONNECT_RESULT |
          NET_EVENT_WIFI_AP_ENABLE_RESULT | NET_EVENT_WIFI_AP_DISABLE_RESULT |
          NET_EVENT_WIFI_AP_STA_CONNECTED | NET_EVENT_WIFI_AP_STA_DISCONNECTED);
  net_mgmt_add_event_callback(&wifi_cb);

  /* Start HTTP server */
  http_server_start();

  LOG_INF("HTTP server started on port %d", http_port);
  LOG_INF("Configure WiFi via shell:");
  LOG_INF("  wifi ap enable %s", ssid);
  LOG_INF("  wifi connect -s \"<ssid>\" -p \"<psk>\" -k 1");

#if HAS_INDEX_HTML
  LOG_INF("Serving: index.html (%d bytes gzipped)", sizeof(index_html_gz));
#endif
#if HAS_APP_JS
  LOG_INF("Serving: app.js (%d bytes gzipped)", sizeof(app_js_gz));
#endif
#if HAS_APP_CSS
  LOG_INF("Serving: app.css (%d bytes gzipped)", sizeof(app_css_gz));
#endif
#if !HAS_INDEX_HTML && !HAS_APP_JS && !HAS_APP_CSS
  LOG_WRN("No web content deployed - showing placeholder page");
#endif

  return 0;
}
```

## src/ws_fusain.c
```c
/*
 * SPDX-License-Identifier: Apache-2.0
 *
 * Fusain WebSocket endpoint - Simulates a diesel burn cycle for testing
 *
 * Cycle (60 seconds total):
 *   0-8s:   PREHEAT        - Glow on, motor ramping up
 *   8-15s:  PREHEAT_STAGE_2 - Glow on, motor at medium speed
 *   15-45s: HEATING        - Burning, pump on, temp rising
 *   45-50s: IDLE           - Everything off, temp falling
 *   50-55s: BLOWING        - Fan mode, motor on
 *   55-60s: IDLE           - Everything off
 *   Repeat...
 */

#include <zephyr/kernel.h>
#include <zephyr/logging/log.h>
#include <zephyr/net/http/server.h>
#include <zephyr/net/http/service.h>
#include <zephyr/net/websocket.h>
#include <zephyr/random/random.h>

#include <fusain/fusain.h>

LOG_MODULE_REGISTER(ws_fusain, LOG_LEVEL_INF);

//////////////////////////////////////////////////////////////
// Config
//////////////////////////////////////////////////////////////

#define WS_FUSAIN_INTERVAL_MS 200
#define WS_FUSAIN_MAX_CLIENTS 2
#define WS_FUSAIN_STACK_SIZE 2048
#define FAKE_DEVICE_ADDRESS 0x0123456789ABCDEFULL

/* Cycle timing (in seconds) */
#define PHASE_PREHEAT_END 8
#define PHASE_PREHEAT2_END 15
#define PHASE_HEATING_END 45
#define PHASE_IDLE1_END 50
#define PHASE_BLOWING_END 55
#define PHASE_IDLE2_END 60 /* Total cycle duration */

//////////////////////////////////////////////////////////////
// State
//////////////////////////////////////////////////////////////

struct ws_fusain_ctx {
  int sock;
  struct k_work_delayable work;
  uint32_t sequence;
};

static struct ws_fusain_ctx fusain_ctx[WS_FUSAIN_MAX_CLIENTS];

K_THREAD_STACK_DEFINE(ws_fusain_stack, WS_FUSAIN_STACK_SIZE);
static struct k_work_q ws_fusain_queue;

/* Cycle start time */
static int64_t cycle_start_ms;

/* Simulated values */
static fusain_state_t sim_state = FUSAIN_STATE_IDLE;
static int32_t sim_motor_rpm = 0;
static int32_t sim_motor_target = 0;
static float sim_temperature = 25.0f;
static bool sim_glow_lit = false;
static int32_t sim_pump_rate = 0;

//////////////////////////////////////////////////////////////
// Cycle Simulation
//////////////////////////////////////////////////////////////

static void update_simulation(void) {
  /* Get elapsed time in cycle (0-60 seconds) */
  int64_t now = k_uptime_get();
  int64_t elapsed_ms = now - cycle_start_ms;
  int32_t cycle_sec = (int32_t)((elapsed_ms / 1000) % PHASE_IDLE2_END);

  /* Determine state based on cycle phase */
  fusain_state_t new_state;
  int32_t target_rpm;
  bool glow;
  int32_t pump;

  if (cycle_sec < PHASE_PREHEAT_END) {
    /* PREHEAT: 0-8s - Motor spins up, glow plug warming
     * Per spec: Ignition RPM = 2500, glow plug warmup = 60s (compressed) */
    new_state = FUSAIN_STATE_PREHEAT;
    target_rpm = 1500 + (cycle_sec * 125); /* Ramp 1500 -> 2500 */
    glow = true;
    pump = 0;
  } else if (cycle_sec < PHASE_PREHEAT2_END) {
    /* PREHEAT_STAGE_2: 8-15s - Fuel injection begins, combustion establishing
     * Per spec: Preheating RPM = 2800, combustion establishing = 190°C */
    new_state = FUSAIN_STATE_PREHEAT_STAGE_2;
    target_rpm = 2800;
    glow = true;
    pump = 500; /* Ignition pump rate: rich mixture */
  } else if (cycle_sec < PHASE_HEATING_END) {
    /* HEATING: 15-45s - Stable combustion
     * Per spec: Normal operation = 215°C, pump rate = 250ms */
    new_state = FUSAIN_STATE_HEATING;
    target_rpm = 2800;
    glow = false; /* Glow off once combustion stable (200°C) */
    pump = 250;   /* Preheating/normal pump rate */
  } else if (cycle_sec < PHASE_IDLE1_END) {
    /* IDLE (post-burn): 45-50s */
    new_state = FUSAIN_STATE_IDLE;
    target_rpm = 0;
    glow = false;
    pump = 0;
  } else if (cycle_sec < PHASE_BLOWING_END) {
    /* BLOWING (fan mode): 50-55s
     * Per spec: Cooldown RPM = 2500 */
    new_state = FUSAIN_STATE_BLOWING;
    target_rpm = 2500;
    glow = false;
    pump = 0;
  } else {
    /* IDLE (pre-cycle): 55-60s */
    new_state = FUSAIN_STATE_IDLE;
    target_rpm = 0;
    glow = false;
    pump = 0;
  }

  /* Log state transitions */
  if (new_state != sim_state) {
    LOG_INF("State: %d -> %d (cycle %ds)", sim_state, new_state, cycle_sec);
  }

  sim_state = new_state;
  sim_motor_target = target_rpm;
  sim_glow_lit = glow;
  sim_pump_rate = pump;

  /* Smoothly ramp motor RPM toward target */
  int32_t rpm_diff = sim_motor_target - sim_motor_rpm;
  if (rpm_diff > 100) {
    sim_motor_rpm += 80 + (sys_rand8_get() % 40);
  } else if (rpm_diff < -100) {
    sim_motor_rpm -= 80 + (sys_rand8_get() % 40);
  } else {
    sim_motor_rpm = sim_motor_target;
  }

  /* Add small RPM jitter when running */
  if (sim_motor_rpm > 0) {
    sim_motor_rpm += (sys_rand8_get() % 20) - 10;
    if (sim_motor_rpm < 0) {
      sim_motor_rpm = 0;
    }
  }

  /* Update temperature based on state
   * Per spec thresholds:
   *   Combustion establishing: 190°C
   *   Combustion stable: 200°C
   *   Normal operation: 215°C */
  if (sim_state == FUSAIN_STATE_PREHEAT) {
    /* Slight temperature rise during preheat from glow plug */
    float target = 40.0f + (cycle_sec * 5.0f); /* 40 -> 80°C over 8s */
    sim_temperature += (target - sim_temperature) * 0.15f;
  } else if (sim_state == FUSAIN_STATE_PREHEAT_STAGE_2) {
    /* Combustion establishing - temp rises toward 190°C */
    float phase_progress = (float)(cycle_sec - PHASE_PREHEAT_END) /
                           (float)(PHASE_PREHEAT2_END - PHASE_PREHEAT_END);
    float target = 80.0f + (110.0f * phase_progress); /* 80 -> 190°C */
    sim_temperature += (target - sim_temperature) * 0.2f;
  } else if (sim_state == FUSAIN_STATE_HEATING) {
    /* Stable combustion - temp at 200-215°C */
    float phase_progress = (float)(cycle_sec - PHASE_PREHEAT2_END) /
                           (float)(PHASE_HEATING_END - PHASE_PREHEAT2_END);
    float target = 200.0f + (15.0f * phase_progress); /* 200 -> 215°C */
    sim_temperature += (target - sim_temperature) * 0.1f;
    /* Add noise */
    sim_temperature += ((float)(sys_rand8_get() % 10) - 5.0f) * 0.1f;
  } else {
    /* Temperature falls toward ambient when not heating */
    float decay_rate = (sim_state == FUSAIN_STATE_BLOWING) ? 2.0f : 0.8f;
    if (sim_temperature > 25.0f) {
      sim_temperature -= decay_rate;
      if (sim_temperature < 25.0f) {
        sim_temperature = 25.0f;
      }
    }
  }

  /* Clamp temperature */
  if (sim_temperature < 20.0f) {
    sim_temperature = 20.0f;
  }
  if (sim_temperature > 220.0f) {
    sim_temperature = 220.0f;
  }
}

//////////////////////////////////////////////////////////////
// WebSocket Handler
//////////////////////////////////////////////////////////////

static void fusain_send_telemetry(struct k_work *work) {
  struct k_work_delayable *dwork = k_work_delayable_from_work(work);
  struct ws_fusain_ctx *ctx = CONTAINER_OF(dwork, struct ws_fusain_ctx, work);

  if (ctx->sock < 0) {
    return;
  }

  fusain_packet_t packet;
  uint8_t tx_buffer[FUSAIN_MAX_PACKET_SIZE * 2];
  int len;
  int ret;
  uint32_t timestamp = k_uptime_get_32();

  /* Update simulation */
  update_simulation();

  /* Rotate through different telemetry types */
  switch (ctx->sequence % 4) {
  case 0:
    /* State data */
    fusain_create_state_data(&packet, FAKE_DEVICE_ADDRESS, 0, FUSAIN_ERROR_NONE,
                             sim_state, timestamp);
    break;

  case 1:
    /* Motor data */
    fusain_create_motor_data(&packet, FAKE_DEVICE_ADDRESS, 0, timestamp,
                             sim_motor_rpm, sim_motor_target);
    break;

  case 2:
    /* Temperature data */
    fusain_create_temp_data(&packet, FAKE_DEVICE_ADDRESS, 0, timestamp,
                            sim_temperature);
    break;

  case 3:
    /* Alternating pump/glow data */
    if (ctx->sequence % 8 < 4) {
      fusain_create_pump_data(&packet, FAKE_DEVICE_ADDRESS, 0, timestamp,
                              FUSAIN_PUMP_EVENT_READY, sim_pump_rate);
    } else {
      fusain_create_glow_data(&packet, FAKE_DEVICE_ADDRESS, 0, timestamp,
                              sim_glow_lit);
    }
    break;
  }

  ctx->sequence++;

  /* Encode the packet */
  len = fusain_encode_packet(&packet, tx_buffer, sizeof(tx_buffer));
  if (len < 0) {
    LOG_ERR("Failed to encode Fusain packet: %d", len);
    goto reschedule;
  }

  /* Send via WebSocket as binary */
  ret = websocket_send_msg(ctx->sock, tx_buffer, len,
                           WEBSOCKET_OPCODE_DATA_BINARY, false, true, 100);
  if (ret < 0) {
    LOG_INF("WebSocket send failed (%d), closing", ret);
    websocket_unregister(ctx->sock);
    ctx->sock = -1;
    return;
  }

reschedule:
  k_work_reschedule_for_queue(&ws_fusain_queue, &ctx->work,
                              K_MSEC(WS_FUSAIN_INTERVAL_MS));
}

static int get_free_slot(void) {
  for (int i = 0; i < WS_FUSAIN_MAX_CLIENTS; i++) {
    if (fusain_ctx[i].sock < 0) {
      return i;
    }
  }
  return -1;
}

int ws_fusain_setup(int ws_socket, struct http_request_ctx *request_ctx,
                    void *user_data) {
  int slot = get_free_slot();
  if (slot < 0) {
    LOG_ERR("No free slots for Fusain WebSocket");
    return -ENOENT;
  }

  fusain_ctx[slot].sock = ws_socket;
  fusain_ctx[slot].sequence = 0;

  LOG_INF("Fusain WebSocket connected (slot %d)", slot);

  /* Start sending telemetry */
  k_work_reschedule_for_queue(&ws_fusain_queue, &fusain_ctx[slot].work,
                              K_NO_WAIT);

  return 0;
}

//////////////////////////////////////////////////////////////
// Initialization
//////////////////////////////////////////////////////////////

static int ws_fusain_init(void) {
  struct k_work_queue_config cfg = {.name = "ws_fusain"};

  k_work_queue_init(&ws_fusain_queue);
  k_work_queue_start(&ws_fusain_queue, ws_fusain_stack, WS_FUSAIN_STACK_SIZE, 0,
                     &cfg);

  for (int i = 0; i < WS_FUSAIN_MAX_CLIENTS; i++) {
    fusain_ctx[i].sock = -1;
    k_work_init_delayable(&fusain_ctx[i].work, fusain_send_telemetry);
  }

  /* Initialize cycle start time */
  cycle_start_ms = k_uptime_get();

  LOG_INF("Fusain WebSocket initialized - 60s burn cycle simulation");
  return 0;
}

SYS_INIT(ws_fusain_init, APPLICATION, 0);
```
